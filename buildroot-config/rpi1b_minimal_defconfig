## buildroot-config/rpi1b_minimal_defconfig
```kconfig
# badprog.com
# Buildroot minimal configuration for Raspberry Pi 1B Rev 2
# Architecture: ARM1176JZF-S (ARMv6) - Hard Float VFPv2

BR2_arm=y
BR2_cortex_a8=n
BR2_ARM_CPU_ARMV6J=y
BR2_ARM_FPU_VFPV2=y
BR2_ARM_EABIHF=y

# Toolchain: internal
BR2_TOOLCHAIN_BUILDROOT=y
BR2_TOOLCHAIN_BUILDROOT_GLIBC=y
BR2_TOOLCHAIN_BUILDROOT_CXX=y

# Linux kernel
BR2_LINUX_KERNEL=y
BR2_LINUX_KERNEL_DEFCONFIG="bcm2835"
BR2_LINUX_KERNEL_ZIMAGE=y
BR2_LINUX_KERNEL_DTS_SUPPORT=y
BR2_LINUX_KERNEL_INTREE_DTS_NAME="broadcom/bcm2835-rpi-b-rev2"

# RPi firmware (bootloader)
BR2_PACKAGE_RPI_FIRMWARE=y
BR2_PACKAGE_RPI_FIRMWARE_BOOTCODE_BIN=y
BR2_PACKAGE_RPI_FIRMWARE_VARIANT_PI=y
BR2_PACKAGE_RPI_FIRMWARE_CONFIG_FILE="board/raspberrypi/config_default.txt"

# SD card image generation
BR2_ROOTFS_POST_IMAGE_SCRIPT="board/raspberrypi/post-image.sh"
BR2_PACKAGE_HOST_GENIMAGE=y
BR2_PACKAGE_HOST_DOSFSTOOLS=y
BR2_PACKAGE_HOST_MTOOLS=y

# Rootfs overlay
BR2_ROOTFS_OVERLAY="$(TOPDIR)/../buildroot-config/overlay"

# Root filesystem
BR2_TARGET_ROOTFS_EXT2=y
BR2_TARGET_ROOTFS_EXT2_4=y

# Busybox
BR2_PACKAGE_BUSYBOX=y

# System
BR2_TARGET_GENERIC_HOSTNAME="badprog-rpi"
BR2_TARGET_GENERIC_ISSUE="Welcome to BadproG GNU/Linux"
BR2_SYSTEM_DHCP="eth0"

# SD card image size
BR2_TARGET_ROOTFS_EXT2_SIZE="120M"
```
